## build/conf/local.conf
```bitbake
DISTRO = "angstrom-2007.1"

#
# Comment out *one* of the two lines below
#DISTRO_TYPE = "debug"
DISTRO_TYPE = "release"

#
# The default build uses uclibc
# Comment out the line below if you want glibc instead of uclibc 
ANGSTROM_MODE = "uclibc"

#
# If you enable glibc and encounter qemu-native build issues
# uncomment the line below.
ENABLE_BINARY_LOCALE_GENERATION=0
```

## com.gumstix.collection/conf/machine/include/gumstix.inc
```bitbake
#@TYPE: Machine
#@Name: Gumstix pxa2xx boards
#@DESCRIPTION:  Gumstix pxa2xx boards

# Don't edit this file unless you *really* know what you are doing!

TARGET_ARCH = "arm"
PACKAGE_EXTRA_ARCHS = "armv4 armv4t armv5e armv5te "

PREFERRED_PROVIDER_virtual/kernel = "gumstix-kernel"
KERNEL_IMAGETYPE = "uImage"
RDEPENDS_kernel-base = ""

UBOOT_ENTRYPOINT = "a0008000"

MACHINE_FEATURES += "kernel26 "
COMBINED_FEATURES ?= ""

IMAGE_FSTYPES = "jffs2"
EXTRA_IMAGECMD_jffs2 = "--little-endian --eraseblock=0x20000 --squash-uids"

SERIAL_CONSOLE = "115200 ttyS0 vt100"

MACHINE_ESSENTIAL_EXTRA_RDEPENDS =     " \
                                       "

MACHINE_ESSENTIAL_EXTRA_RRECOMMENDS ?= " \
                                       "
```
